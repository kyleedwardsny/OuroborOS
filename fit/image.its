## fit/image.its
```
/dts-v1/;

/ {
	description = "OuroborOS boot image";
	#address-cells = <1>;

	images {
		ou_ikernel: kernel@1 {
			hash@1 {
				algo = "crc32";
			};
			hash@2 {
				algo = "sha1";
			};
		};

		ou_fdt: fdt@1 {
			hash@1 {
				algo = "crc32";
			};
			hash@2 {
				algo = "sha1";
			};
		};

		ramdisk@1 {
			description = "OuroborOS ramdisk";
			data = /incbin/("../build/ldinitrd/ldinitrd.bin");
			type = "ramdisk";
			arch = "mips";
			os = "linux";
			compression = "none";
		};
	};

	configurations {
		default = "config@1";
		config@1 {
			description = "Boot OuroborOS";
			kernel = "kernel@1";
			fdt = "fdt@1";
			ramdisk = "ramdisk@1";
		};
	};
};

/include/ "fit/ikernel.itsi"
/include/ "fit/fdt.itsi"
```

## image.its
```
/dts-v1/;

/ {
	description = "OuroborOS boot image";
	#address-cells = <1>;

	images {
		ou_ikernel: kernel@1 {
			hash@1 {
				algo = "crc32";
			};
			hash@2 {
				algo = "sha1";
			};
		};

		fdt@1 {
			description = "my-fdt";
			data = /incbin/("dts/qemu_mips.dtb");
			type = "flat_dt";
			arch = "mips";
			compression = "none";
		};
	};

	configurations {
		default = "config@1";
		config@1 {
			description = "Boot OuroborOS";
			kernel = "kernel@1";
			fdt = "fdt@1";
		};
	};
};

/include/ "kernel.itsi"
```
